## menuconfig/main/Kconfig.projbuild
```kconfig
menu "Networking Features"
    menu IPV6
        config IPV6_SUPPORT
            bool "Enable or Disable IPv6"
            default  n
            help
                This flag enables or disables IPv6 feature
        config NUM_OF_IPV6_ADDR
            int "NUmber of IPv6 Addresses"
            range 1 3
            default 1
            help
                Number of IPv6 address can be used
        config DHCPV6_MODE
            choice
                bool "Select a Choice"
                    default DHCP
                config STATIC
                    bool "Static IPv6 Assignment"
                config DHCP
                    bool "Dynamic IPv6 Assignment"
            endchoice
    endmenu
endmenu
```

## wifi-sniffer/main/Kconfig.projbuild
```kconfig
menu "Custom WiFi Configuration"

    config CUSTOM_WIFI_SSID
        string "WiFi SSID"
        default "MyESP32WiFi"
        help
            Set the SSID for the WiFi connection.
    
    config CUSTOM_WIFI_PASSWORD
        string "WiFi Password"
        default "password123"
        help
            Set the password for the WiFi connection.

    config CUSTOM_WIFI_SNIFF_CHANNEL
        int "WiFi Sniffing Channel"
        default 1
        help
            Set the channel number to sniff.

    config CUSTOM_WIFI_MAX_RETRIES
        int "Maximum WiFi Connection Retries"
        range 1 10
        default 5
        help
            Define how many times the device should retry connecting to WiFi.
    
    config CUSTOM_ENABLE_DEBUG
        bool "Enable Debug Logging"
        default n
        help
            Enable detailed debug logs for troubleshooting.
    
    endmenu
    
```
